## CMakeLists.txt
```
cmake_minimum_required(VERSION 3.20.0)
find_package(Zephyr REQUIRED HINTS $ENV{ZEPHYR_BASE})

project(scratch)

target_sources(app PRIVATE
	src/main.c
	src/utils.c
	src/gf.c
	src/ghash.c
	src/aesctr.c
)
```

## prj.conf
```kconfig
CONFIG_NRF_SECURITY=y
CONFIG_MBEDTLS_LEGACY_CRYPTO_C=y
CONFIG_MBEDTLS_AES_C=y
CONFIG_MBEDTLS_ENABLE_HEAP=y
CONFIG_MBEDTLS_HEAP_SIZE=8192

# RTT console
CONFIG_USE_SEGGER_RTT=y
CONFIG_RTT_CONSOLE=y
CONFIG_UART_CONSOLE=n
CONFIG_CONSOLE=y
```

## src/main.c
```c
#include <stdio.h>
#include <string.h>
#include <stdint.h>
#include "utils.h"
#include "gf.h"
#include "ghash.h"
#include "aesctr.h"

static void print_hex(const char *label, const uint8_t *buf, size_t n)
{
    printf("%s", label);
    for (size_t i = 0; i < n; i++) {
        printf("%02x", buf[i]);
    }
    printf("\n");
}

static void test_aes_gcm(void)
{
    /* Same key/nonce/plaintext as demo (mbedTLS GCM) */
    const uint8_t key[16] = {0x00, 0x01, 0x02, 0x03, 0x04, 0x05, 0x06, 0x07,
                             0x08, 0x09, 0x0a, 0x0b, 0x0c, 0x0d, 0x0e, 0x0f};
    const uint8_t nonce[12] = {0xa0,0xa1,0xa2,0xa3,0xa4,0xa5,0xa6,0xa7,0xa8,0xa9,0xaa,0xab};
    const uint8_t plaintext[] = "Hello World!";
    const size_t len = strlen((const char *)plaintext);

    uint8_t ciphertext[64] = {0};
    uint8_t tag[16] = {0};
    uint8_t decrypted[64] = {0};

    printf("AES-GCM Encryption/Decryption (our implementation)\n");

    /* Encrypt */
    aes_gcm_encrypt(key, nonce, NULL, 0, plaintext, len, ciphertext, tag);

    printf("PT:  %s\n", plaintext);
    print_hex("CT: ", ciphertext, len);
    print_hex("TAG: ", tag, 16);

    /* Decrypt and verify tag */
    if (aes_gcm_decrypt(key, nonce, NULL, 0, ciphertext, len, tag, decrypted) != 0) {
        printf("Decryption/verification failed!\n");
        return;
    }

    decrypted[len] = '\0';
    printf("DEC: %s\n", decrypted);
}

int main(void)
{
    test_aes_gcm();
    return 0;
}
```

## src/aesctr.c
```c
#include "aesctr.h"
#include "ghash.h"
#include <mbedtls/aes.h>
#include <string.h>

static void inc_be32(uint8_t ctr[16]) { for (int i = 15; i >= 12; i--) if (++ctr[i]) break; }

static int ct_memcmp(const uint8_t *a, const uint8_t *b, size_t n)
{
    uint8_t diff = 0;
    for (size_t i = 0; i < n; i++) {
        diff |= (uint8_t)(a[i] ^ b[i]);
    }
    return diff;
}

void aes_encrypt_block(const uint8_t key[16], const uint8_t in[16], uint8_t out[16])
{
    mbedtls_aes_context ctx; mbedtls_aes_init(&ctx);
    mbedtls_aes_setkey_enc(&ctx, key, 128);
    mbedtls_aes_crypt_ecb(&ctx, MBEDTLS_AES_ENCRYPT, in, out);
    mbedtls_aes_free(&ctx);
}

void aes_ctr_encrypt(const uint8_t key[16], const uint8_t nonce[12], const uint8_t *pt, size_t len, uint8_t *ct)
{
    uint8_t counter[16] = {0};
    memcpy(counter, nonce, 12);
    counter[15] = 1; /* J0 = nonce || 0x00000001 for 96-bit nonce */
    inc_be32(counter); /* GCTR payload starts at inc32(J0) */

    size_t off = 0; uint8_t stream[16], block[16];
    while (off < len) {
        aes_encrypt_block(key, counter, stream);
        size_t chunk = (len - off) < 16 ? (len - off) : 16;
        memcpy(block, pt + off, chunk);
        for (size_t i = 0; i < chunk; i++) ct[off + i] = block[i] ^ stream[i];
        off += chunk; inc_be32(counter);
    }
}

void aes_gcm_encrypt(const uint8_t key[16], const uint8_t nonce[12],
                       const uint8_t *aad, size_t aad_len,
                       const uint8_t *pt, size_t len,
                       uint8_t *ct, uint8_t tag[16])
{
    uint8_t zero[16] = {0};
    uint8_t H[16];
    uint8_t J0[16] = {0};
    uint8_t S[16];
    uint8_t GH[16];

    aes_encrypt_block(key, zero, H);

    memcpy(J0, nonce, 12);
    J0[15] = 1; /* 96-bit nonce fast path */

    aes_ctr_encrypt(key, nonce, pt, len, ct);

    ghash(H, aad, aad_len, ct, len, GH);
    aes_encrypt_block(key, J0, S);

    for (int i = 0; i < 16; i++) {
        tag[i] = (uint8_t)(S[i] ^ GH[i]);
    }
}

int aes_gcm_decrypt(const uint8_t key[16], const uint8_t nonce[12],
                      const uint8_t *aad, size_t aad_len,
                      const uint8_t *ct, size_t len,
                      const uint8_t tag[16], uint8_t *pt)
{
    uint8_t zero[16] = {0};
    uint8_t H[16];
    uint8_t J0[16] = {0};
    uint8_t S[16];
    uint8_t GH[16];
    uint8_t expected[16];

    aes_encrypt_block(key, zero, H);

    memcpy(J0, nonce, 12);
    J0[15] = 1;

    ghash(H, aad, aad_len, ct, len, GH);
    aes_encrypt_block(key, J0, S);

    for (int i = 0; i < 16; i++) {
        expected[i] = (uint8_t)(S[i] ^ GH[i]);
    }

    if (ct_memcmp(expected, tag, 16) != 0) {
        return -1;
    }

    aes_ctr_encrypt(key, nonce, ct, len, pt);
    return 0;
}
```

## src/aesctr.h
```c
#ifndef AESCTR_H
#define AESCTR_H
#include <stdint.h>
#include <stddef.h>

void aes_encrypt_block(const uint8_t key[16], const uint8_t in[16], uint8_t out[16]);
void aes_ctr_encrypt(const uint8_t key[16], const uint8_t nonce[12], const uint8_t *pt, size_t len, uint8_t *ct);

void aes_gcm_encrypt(const uint8_t key[16], const uint8_t nonce[12],
					   const uint8_t *aad, size_t aad_len,
					   const uint8_t *pt, size_t len,
					   uint8_t *ct, uint8_t tag[16]);

int aes_gcm_decrypt(const uint8_t key[16], const uint8_t nonce[12],
					  const uint8_t *aad, size_t aad_len,
					  const uint8_t *ct, size_t len,
					  const uint8_t tag[16], uint8_t *pt);
#endif
```
